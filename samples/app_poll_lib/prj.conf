## CMakeLists.txt
```
cmake_minimum_required(VERSION 3.20.0)
find_package(Zephyr REQUIRED HINTS $ENV{ZEPHYR_BASE})
project(app_poll_lib_basic)

target_sources(app PRIVATE src/main.c)
target_link_libraries(app PRIVATE zephyr_interface zephyr)
```

## prj.conf
```kconfig
CONFIG_APP_POLL_LIB=y
CONFIG_LOG=y
CONFIG_LOG_DEFAULT_LEVEL=3
```

## src/main.c
```c
#include <app_poll_lib/app_poll_lib.h>
#include <zephyr/kernel.h>

int main(void) {
  app_poll_lib_init();

  while (1) {
    k_sleep(K_SECONDS(1));
  }
}
```
